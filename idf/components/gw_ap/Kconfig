## idf/components/gw_ap/Kconfig
```kconfig
menu "Gateway: commissioning access point"

    config GW_SOFTAP
        bool "Wi-Fi access point for commissioning (NET-5)"
        depends on GW_WIFI
        default y
        help
            Starts an access point "GW-Setup-XXXXXX" (last bytes of the MAC) when there is no
            valid configuration (rejected, after a factory reset, safe mode, PSRAM fault) and on
            a 2-10 s press of BOOT. WPA2 with the web password (issue #187: the gateway keeps
            only its PMK), or with the device's commissioning password while no web password
            is set; open (no key) only during a claim window (issue #120). The web UI is then
            at the address of the access point (192.168.4.1, the ESP-IDF default): https with
            the default web.https (plain HTTP only redirects), http with web.https false. The
            log line gives the address in use.
            Needs the Wi-Fi driver (CONFIG_GW_WIFI): QEMU has no radio (the emulator build
            runs a simulated access point instead).

    config GW_SOFTAP_TIMEOUT_MIN
        int "Longest time of the access point after a BOOT press in normal mode (min)"
        depends on GW_SOFTAP || GW_IO_SIMULATED
        range 1 1440
        default 30
        help
            With a valid configuration, the access point stops at the end of this time, also
            with a client. In the modes without a valid configuration there is no longest time:
            only GW_SOFTAP_IDLE_MIN stops it.

    config GW_SOFTAP_IDLE_MIN
        int "Minutes without a client that stop the access point (issue #187)"
        depends on GW_SOFTAP || GW_IO_SIMULATED
        range 1 60
        default 5
        help
            The access point stops after this time without a client, in every mode (normal,
            recovery, commissioning, safe mode, PSRAM fault). The time counts from the start
            and from the moment the last client leaves. A new BOOT press of 2-10 s starts the
            access point again.

endmenu
```

## idf/components/gw_board/Kconfig
```kconfig
menu "Gateway: board I/O"

    config GW_IO_SIMULATED
        bool "Simulated local I/O (emulator only)"
        default n
        help
            Replaces the GPIO inputs, the I2C output expander and the RGB LED by RAM
            models so the firmware runs under QEMU. DI levels are then set from the
            console shell with "di <1-8> <0|1>". Never enable on hardware.

    config GW_DI_SAMPLE_US
        int "DI sampling period (us)"
        range 250 1000
        default 1000

    config GW_LOCAL_IO_TASK_PRIORITY
        int "Local I/O task priority"
        default 9
        help
            The local_io task is the only writer of the DO expander: DO commands (NCMD),
            the safe state (IO-3) and the local rules (IO-7).

    config GW_LED_BRIGHTNESS
        int "Status LED brightness (0-255)"
        range 1 255
        default 40

endmenu
```

## idf/components/gw_bsp/Kconfig
```kconfig
menu "Gateway: board (Waveshare ESP32-S3-POE-ETH-8DI-8DO)"

    config GW_DI_ACTIVE_LOW
        bool "DI inputs are active low"
        default y
        help
            Waveshare's demo configures GPIO4-11 with pull-ups and ESPHome marks them
            inverted: an energised input pulls the GPIO low. The internal pull-ups are
            enabled only for active-low inputs.

    config GW_DO_ACTIVE_LOW
        bool "DO outputs are active low (LOW expander pin = output on)"
        default y
        help
            Waveshare's demo loads 0xFF into the TCA9554 at boot and mirrors the raw DI
            levels onto the DOs, and ESPHome declares the 8 outputs inverted: a LOW pin
            energises the output. The latch is loaded with the OFF level of every
            channel before the pins become outputs. Verify on the board before use.

endmenu
```

## idf/components/gw_bus/Kconfig
```kconfig
menu "Gateway: Modbus bus task"

    config GW_BUS_TASK_PRIORITY
        int "RS485 owner task priority"
        default 10

    config GW_BUS_TASK_CORE
        int "RS485 owner task core"
        range 0 1
        default 1
        help
            Core 1 keeps bus timing away from the network stack (lwIP, esp_eth, MQTT on core 0).

    config GW_BUS_WRITE_QUEUE_LEN
        int "Pending DCMD writes"
        range 1 32
        default 8

    config GW_MB_BLOCK_READS
        bool "Merge adjacent tags into block reads (MB-11)"
        default y
        help
            Default for devices without "block_reads" in the configuration.

    config GW_MB_BLOCK_MAX_GAP
        int "Largest unused register/bit gap bridged by a block read"
        range 0 32
        default 0
        depends on GW_MB_BLOCK_READS
        help
            Default for devices without "max_gap" in the configuration.

    config GW_MB_OFFLINE_PROBE_MAX_MS
        int "Longest interval between probes of an offline device (ms)"
        range 0 600000
        default 10000
        help
            An offline device is probed with a single attempt (no retries) at 2, 4, 8 ...
            times its poll_ms, up to this value (never less often than poll_ms), so a
            dead slave does not take the bus from the healthy ones. A device that answers
            again is back online (DBIRTH) at most this long plus one poll cycle later.

    config GW_MB_FORCE_MULTI_WRITE
        bool "Always write with FC15/FC16 (for slaves without FC05/FC06)"
        default n

endmenu
```

## idf/components/gw_edge/Kconfig
```kconfig
menu "Gateway: Sparkplug / MQTT"

    config GW_EDGE_TASK_PRIORITY
        int "Sparkplug task priority"
        default 8

    config GW_EDGE_TASK_CORE
        int "Sparkplug task core"
        range 0 1
        default 0

    config GW_EDGE_QUEUE_LEN
        int "Sparkplug task event queue length"
        range 8 64
        default 24

    config GW_CMD_SLOTS
        int "Inbound NCMD/DCMD buffers"
        range 1 16
        default 4

    config GW_CMD_MAX_PAYLOAD
        int "Largest inbound NCMD/DCMD payload (bytes)"
        range 128 4096
        default 1024

    config GW_SPB_PAYLOAD_INTERNAL
        int "QEMU build without PSRAM: Sparkplug payload buffer (bytes)"
        depends on GW_EMU_NO_PSRAM
        range 4096 16384
        default 6144
        help
            The payload buffer is in PSRAM and holds the largest birth the configuration
            allows (16 KB: templates, diagnostics and every property). Only the QEMU build
            without PSRAM (GW_EMU_NO_PSRAM, issue #135) has this smaller buffer, from
            internal RAM; a birth that does not fit is logged and its device stays unborn.

    config GW_MQTT_BUFFER_SIZE
        int "esp-mqtt send/receive buffer (bytes)"
        default 2048

    config GW_MQTT_OUTBOX_LIMIT
        int "esp-mqtt outbox limit (bytes, QoS>0 messages awaiting ACK)"
        default 8192

    config GW_MQTT_PUBLISH_BUDGET_MS
        int "Longest a single MQTT publish may take (ms)"
        range 1000 9000
        default 8000
        help
            Issue #59: esp-mqtt keeps writing a message while every socket write makes
            progress, so on a very slow link one publish (a DBIRTH of up to 6 KB) could
            outlast the task watchdog. After this long the connection is closed (the
            Sparkplug session restarts with backoff). The write in progress may still take
            up to the 5 s socket timeout: keep budget + 5 s below the 15 s watchdog.

    config GW_MQTT_BACKOFF_MIN_MS
        int "Reconnect backoff minimum (ms)"
        default 1000

    config GW_MQTT_BACKOFF_MAX_MS
        int "Reconnect backoff maximum (ms)"
        default 60000

    config GW_SNTP_WAIT_MS
        int "Wait for SNTP before the first MQTT connection (ms)"
        range 0 30000
        default 3000
        help
            Births carry better timestamps if the clock is set first. The connection
            proceeds without synchronised time once this expires.

    config GW_SF_SAMPLES
        int "Store & forward: samples kept in the RAM ring (24 B each)"
        range 64 8192 if GW_EMU_NO_PSRAM
        range 1000 400000
        default 512 if GW_EMU_NO_PSRAM
        default 40000
        help
            SPB-14, with sparkplug.store_forward: changes made while there is no Sparkplug
            session are kept in a ring of this many metric samples, allocated once at boot
            in PSRAM (40000 = 960 KB). When full, the oldest samples are overwritten (or
            spilled to the microSD card, sparkplug.store_forward.sd). The QEMU build
            without PSRAM (GW_EMU_NO_PSRAM, issue #135) has 512 samples (12 KB) in
            internal RAM.

endmenu
```

## idf/components/gw_fw/Kconfig
```kconfig
menu "Gateway: firmware updates (FW-1)"

    config GW_FW_SELFCHECK_S
        int "Least uptime of a new firmware before its self-check confirms it (s)"
        range 10 600
        default 60
        help
            Issue #144: a new image boots on trial. The self-check confirms it at the first
            instant when the uptime is at least this value, the gateway is in its expected
            mode, the network driver started and the web server loop is alive. It does not
            depend on the broker, the Modbus slaves, NTP or the update server. A reset
            before the confirmation (crash, watchdog, power cut) returns to the earlier
            image.

    config GW_FW_BACKSTOP_S
        int "Uptime at which a new firmware whose self-check is not true is rejected (s)"
        range 60 3600
        default 300
        help
            Issue #144: without a true self-check at this uptime, the image is rejected
            (planned restart: the bootloader returns to the earlier image). An esp_timer does
            the same 10 s later when the main task is blocked.

    config GW_FW_BOOTLOOP_CLEAR_S
        int "Uptime in normal mode that clears the boot-loop counter (s)"
        range 10 3600
        default 120
        help
            Issue #144: the boot-loop counter (crash resets in a row, RTC memory) starts safe
            mode at 3. It is cleared after this uptime in normal mode.

    config GW_FW_SAFE_MODE_MIN
        int "Duration of safe mode before normal mode is tried again (min)"
        range 1 1440
        default 60
        help
            Issue #144: safe mode (recovery mode with the cause "repeated crashes") ends
            after this time with a restart, and the counter at 2: one more crash starts safe
            mode again. A restart by the operator or a power cycle also ends it.

    config GW_FW_HTTP_TIMEOUT_MS
        int "Network timeout of a firmware download (ms)"
        range 1000 60000
        default 10000

    config GW_FW_TASK_STACK
        int "Stack of the download task (bytes)"
        range 6144 16384
        default 8192
        help
            The task exists only while a download runs (TLS handshake included), or while
            the image of the other slot is verified (the "Restart into" button).

    config GW_FW_TASK_PRIORITY
        int "Priority of the download task"
        range 1 7
        default 2

    config GW_FW_PARK_OTHER_CORE
        bool "Park the other core while an image is verified (QEMU only)"
        depends on GW_IO_SIMULATED
        default n
        help
            Espressif's QEMU does not model the ESP32-S3 cache freeze that flash mappings
            use: code the other core runs from flash during esp_image_verify() makes QEMU
            abort. With this option a high-priority task spins in IRAM on the other core
            for those calls. Not needed (and not wanted) on the chip: there it would stop
            core 1, where the RS485 bus owner runs, during a real update. So it is only
            offered in the emulator build (GW_IO_SIMULATED).

endmenu
```

## idf/components/gw_log/Kconfig
```kconfig
menu "Gateway: remote syslog"

    config GW_SYSLOG_SLOTS
        int "Log lines buffered for the syslog server"
        range 8 256
        default 32
        help
            Each slot holds one line (about 250 bytes), allocated at boot in PSRAM
            and only if the configuration enables syslog. When the buffer is
            full (no network, slow sender) new lines are dropped and counted; the console
            still shows them.

    config GW_LOG_RING_KB
        int "Live log of the web UI: size of the ring (KB)"
        range 2 64
        default 2 if GW_EMU_NO_PSRAM
        default 16
        help
            Issue #200: the last log lines for GET /api/log and the card Log of the web UI.
            The firmware allocates the ring and a copy buffer of the same size one time at
            boot, in PSRAM (2 x this size). The QEMU build without PSRAM uses internal RAM:
            2 KB there.

    config GW_SYSLOG_TASK_PRIORITY
        int "Syslog sender task priority"
        range 1 10
        default 2

endmenu
```

## idf/components/gw_mbtcp/Kconfig
```kconfig
menu "Gateway: Modbus TCP gateway"

    config GW_MBTCP_MAX_CLIENTS
        int "Simultaneous Modbus TCP clients"
        range 1 4
        default 2
        help
            Further connections are closed at once. Requests of every client are served one
            at a time, like everything else on the RS485 bus.

    config GW_MBTCP_TASK_PRIORITY
        int "Modbus TCP server task priority"
        range 1 10
        default 3

    config GW_MBTCP_RESPONSE_WAIT_MS
        int "Longest wait for the bus owner to run a forwarded request (ms)"
        range 500 12000
        default 8000
        help
            The request waits for the transaction in progress and the pending DCMD writes.
            If the bus owner has not run it in this time the client gets exception 0x0B
            (gateway target device failed to respond).

endmenu
```

## idf/components/gw_net/Kconfig
```kconfig
menu "Gateway: network"

    choice GW_ETH_BACKEND
        prompt "Ethernet MAC"
        default GW_ETH_W5500

        config GW_ETH_W5500
            bool "WIZnet W5500 over SPI (board; pins in gw_bsp)"

        config GW_ETH_OPENETH
            bool "OpenCores Ethernet (QEMU only)"
            select ETH_USE_OPENETH
    endchoice

    config GW_WIFI
        bool "Wi-Fi station as alternative or backup of Ethernet (NET-4)"
        depends on SOC_WIFI_SUPPORTED
        default y
        help
            Compiles the Wi-Fi station driver. It is only started when the configuration
            enables network.wifi; Ethernet-only configurations behave as without it.
            QEMU does not emulate the radio: the emulator build disables this.

    config GW_NET_NO_SERVICE_MIN_S
        int "Hold of an interface without a path to the broker, first time (s)"
        range 10 3600
        default 60
        help
            Issue #57, with Ethernet and Wi-Fi: when every broker failed over the active
            interface although it has link and an address, the session moves to the other
            one and this interface is not chosen again for this long. Each report in a row
            doubles it, up to GW_NET_NO_SERVICE_MAX_S; a stable session resets it.

    config GW_NET_NO_SERVICE_MAX_S
        int "Hold of an interface without a path to the broker, maximum (s)"
        range 10 86400
        default 1800

endmenu
```

## idf/components/gw_rs485/Kconfig
```kconfig
menu "Gateway: RS485 port"

    config GW_RS485_HW_HALF_DUPLEX
        bool "Hardware RS485 half-duplex mode (UART_MODE_RS485_HALF_DUPLEX)"
        default y
        help
            The UART driver asserts RTS (the transceiver's DE, see gw_bsp) while
            transmitting and releases it on TX_DONE. Disable only for emulators that do
            not model the RS485 UART mode.

endmenu
```
