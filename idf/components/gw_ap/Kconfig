## idf/components/gw_shell/Kconfig
```kconfig
menu "Gateway: console shell"

    config GW_SHELL_WRITE_COMMANDS
        bool "Shell commands that change the gateway (config load, restart, rebirth, mbread, card format, coredump erase)"
        default y
        help
            CFG-6. The console is reached only with physical access to the board (USB-C),
            which also gives the BOOT button and the flash. Production builds that want a
            read-only console (status, devices, config, config show, ping, coredump,
            coredump dump) turn this off.

endmenu
```

## idf/components/gw_storage/Kconfig
```kconfig
menu "Gateway: storage"

    config GW_EMU_NO_PSRAM
        bool
        default y if GW_IO_SIMULATED && !SPIRAM
        help
            Issue #135: the firmware assumes the 8 MB of PSRAM of the board. A board whose
            PSRAM is not detected boots in the fault mode only (network, web server and
            shell report the fault; the gateway does not start). This hidden option is set
            only in the QEMU build without PSRAM (sdkconfig.qemu: CONFIG_GW_IO_SIMULATED and
            no CONFIG_SPIRAM). There the gateway runs from internal RAM, with the small
            sizes of CONFIG_GW_SPB_PAYLOAD_INTERNAL and CONFIG_GW_SF_SAMPLES, for the E2E
            scenarios that do not depend on memory (they run faster without PSRAM).

    config GW_CONFIG_MAX_BYTES
        int "Largest accepted /cfg/config.json (bytes)"
        range 4096 1048576
        default 131072
        help
            The spec maximum (16 devices, 256 tags with every field) is about 46 KB of
            compact JSON and 82 KB indented with 2 spaces. The file and the parser's
            document tree (about 200 KB for 256 tags) are allocated at boot, in PSRAM,
            and freed before the gateway starts. A larger file is
            rejected: the gateway then stays stopped with the configuration error state.

    choice GW_SF_SPILL
        prompt "Store & forward spill (SPB-14, sparkplug.store_forward.sd)"
        default GW_SF_SPILL_SDMMC
        help
            Where the store & forward ring spills when it is full, if the configuration
            enables it (off by default). GPIO45, the card's D0, is a strapping pin: see
            docs/reference/store-and-forward.md#the-microsd-card-and-gpio45 before enabling it
            on a board.

        config GW_SF_SPILL_SDMMC
            bool "microSD card on SDMMC, 1-bit (CLK 48, CMD 47, D0 45)"

        config GW_SF_SPILL_LITTLEFS
            bool "A directory of the LittleFS partition (QEMU stand-in for the card)"

        config GW_SF_SPILL_NONE
            bool "None"
    endchoice

endmenu
```

## idf/components/gw_web/Kconfig
```kconfig
menu "Gateway: web"

    config GW_MDNS
        bool "mDNS responder and _http._tcp announcement (NET-6)"
        default y
        help
            Answers <network.hostname>.local and announces the web UI. Turned off per device
            with network.mdns = false.

    config GW_WEB_LOGIN_MAX_FAILS
        int "Failed logins in a row before a source address is blocked"
        range 1 100
        default 5

    config GW_WEB_LOGIN_BLOCK_S
        int "First block of a source address (s)"
        range 1 3600
        default 30
        help
            Issue #64: after GW_WEB_LOGIN_MAX_FAILS failed logins in a row an address gets
            429 for this long, without any password check; every further block in a row
            doubles it, up to GW_WEB_LOGIN_BLOCK_MAX_S. A successful login resets it.

    config GW_WEB_LOGIN_BLOCK_MAX_S
        int "Longest block of a source address (s)"
        range 1 86400
        default 900

    config GW_WEB_CLAIM_WINDOW_MIN
        int "Minutes of the claim window after a BOOT push (issue #120)"
        range 1 30
        default 10
        help
            CFG-3 / NET-5: while no web password is set, the BOOT push of 2-10 s opens a
            claim window for this time. During the window, a client of the commissioning
            access point (open, no key, for the same time) can set the first web password at
            /claim without a credential. The window closes at the end of this time, after the
            first password that is set through it, and at a restart.

    config GW_WEB_STALL_S
        int "Longest time a web server may be held by one incoming request (s), 0 = off"
        range 0 300
        default 8
        help
            Issue #110: esp_http_server serves every session from one task and reads a TLS
            handshake and the request headers with blocking receives. A client that sends them
            byte by byte (slowloris) or stops half-way holds the whole web UI and API. If a
            server has been held this long outside the gateway's handlers (and outside the
            drain of a refused authenticated upload), its sessions are shut down.

endmenu
```

## zephyr/boards/waveshare/esp32s3_poe_eth_8di_8do/Kconfig
```kconfig
# SPDX-License-Identifier: Apache-2.0

config HEAP_MEM_POOL_ADD_SIZE_BOARD
	int
	default 4096 if BOARD_ESP32S3_POE_ETH_8DI_8DO_ESP32S3_PROCPU
```

## zephyr/boards/waveshare/esp32s3_poe_eth_8di_8do/board.yml
```yaml
board:
  name: esp32s3_poe_eth_8di_8do
  full_name: ESP32-S3-POE-ETH-8DI-8DO
  vendor: waveshare
  socs:
    - name: esp32s3
```

## zephyr/tests/unit/testcase.yaml
```yaml
tests:
  gateway.unit:
    platform_allow:
      - native_sim
      - native_sim/native/64
    integration_platforms:
      - native_sim
    tags: gateway
    harness: ztest
```
