## CMakeLists.txt
```
# SPDX-License-Identifier: Apache-2.0
#
# Host unit tests (QA-1) of the gateway's pure modules, run on native_sim.

cmake_minimum_required(VERSION 3.20.0)

find_package(Zephyr REQUIRED HINTS $ENV{ZEPHYR_BASE})
project(gw_unit_tests)

set(APP_DIR ${CMAKE_CURRENT_SOURCE_DIR}/../..)

list(APPEND CMAKE_MODULE_PATH ${ZEPHYR_BASE}/modules/nanopb)
include(nanopb)
# Generate from the firmware's proto so the include path ("proto/...") matches.
set(NANOPB_GENERATE_CPP_STANDALONE OFF)
nanopb_generate_cpp(proto_srcs proto_hdrs RELPATH ${APP_DIR} ${APP_DIR}/proto/sparkplug_b.proto)
target_include_directories(app PRIVATE ${CMAKE_CURRENT_BINARY_DIR} ${APP_DIR}/src)
target_sources(app PRIVATE ${proto_srcs} ${proto_hdrs})

target_sources(app PRIVATE
  ${APP_DIR}/src/config.c
  ${APP_DIR}/src/json_reader.c
  ${APP_DIR}/src/convert.c
  ${APP_DIR}/src/debounce.c
  ${APP_DIR}/src/model.c
  ${APP_DIR}/src/sparkplug.c
  ${APP_DIR}/src/spb_node.c
  ${APP_DIR}/src/status_led.c
  src/test_backoff_led.c
  src/test_config.c
  src/test_convert.c
  src/test_debounce.c
  src/test_rbe.c
  src/test_sparkplug.c
  src/test_spb_node.c
  src/test_util.c
)
```

## Kconfig
```
# SPDX-License-Identifier: Apache-2.0
rsource "../../Kconfig.gw"
source "Kconfig.zephyr"
```

## prj.conf
```kconfig
CONFIG_ZTEST=y
CONFIG_ZTEST_STACK_SIZE=16384
CONFIG_NANOPB=y
CONFIG_LOG=y
CONFIG_LOG_MODE_IMMEDIATE=y
CONFIG_GW_LOG_LEVEL_DBG=y
CONFIG_LED_STRIP=n
```

## src/test_backoff_led.c
```c
/*
 * Reconnection back-off (MQTT-2) and status LED priorities (IO-5).
 *
 * SPDX-License-Identifier: Apache-2.0
 */

#include <zephyr/ztest.h>

#include "backoff.h"
#include "model.h"
#include "status_led.h"

ZTEST(backoff, test_bounds)
{
	uint32_t ceiling = 1000;

	for (uint32_t attempt = 0; attempt < 40; attempt++) {
		static const uint32_t rnd[] = {0, 1, 499, 0x9e3779b9, UINT32_MAX};
		uint32_t lo = MAX(ceiling / 2, BACKOFF_MIN_MS);

		for (size_t i = 0; i < ARRAY_SIZE(rnd); i++) {
			uint32_t d = backoff_delay_ms(attempt, rnd[i]);

			zassert_true(d >= lo && d <= ceiling, "attempt %u: %u not in [%u, %u]",
				     attempt, d, lo, ceiling);
		}
		ceiling = MIN(ceiling * 2, BACKOFF_MAX_MS);
	}
	zassert_equal(backoff_delay_ms(0, 0), 1000, "first retry after 1 s");
	zassert_equal(backoff_delay_ms(30, 30000), 60000, "capped at 60 s");
	zassert_equal(backoff_delay_ms(30, 0), 30000, "jitter spans half the ceiling");
}

static bool is(struct status_rgb c, uint8_t r, uint8_t g, uint8_t b)
{
	return c.r == r && c.g == g && c.b == b;
}

ZTEST(status_led, test_priorities)
{
	uint32_t ok = GW_STATUS_NET_UP | GW_STATUS_MQTT_UP;

	zassert_true(is(status_led_color(ok, 0), 0, 40, 0), "operating: green");
	zassert_true(is(status_led_color(ok | GW_STATUS_MODBUS_ERROR, 0), 40, 10, 0),
		     "modbus error: orange");
	zassert_true(is(status_led_color(GW_STATUS_NET_UP, 0), 40, 40, 0), "no broker: yellow");
	zassert_true(is(status_led_color(GW_STATUS_NET_UP, 600), 0, 0, 0), "slow blink");
	zassert_true(is(status_led_color(0, 0), 40, 0, 0), "no network: red");
	zassert_true(is(status_led_color(ok | GW_STATUS_CONFIG_ERROR, 0), 40, 0, 0));
	zassert_true(is(status_led_color(ok | GW_STATUS_CONFIG_ERROR, 130), 0, 0, 0),
		     "config error blinks fast");
}

ZTEST_SUITE(backoff, NULL, NULL, NULL, NULL, NULL);
ZTEST_SUITE(status_led, NULL, NULL, NULL, NULL, NULL);
```

## src/test_config.c
```c
/*
 * Configuration parsing and validation (CFG-1, SPEC section 6).
 *
 * SPDX-License-Identifier: Apache-2.0
 */

#include <stdio.h>
#include <string.h>

#include <zephyr/ztest.h>

#include "gw_config.h"
#include "test_util.h"

#define MINIMAL_HEAD                                                                         \
	"{\"mqtt\":{\"host\":\"broker\"},\"sparkplug\":{\"group_id\":\"G\",\"edge_node_id\":\"N\"}"

ZTEST(config, test_spec_example)
{
	const struct gw_config *c = test_config_load(spec_config_json);
	const struct gw_tag_cfg *t = c->tags;

	zassert_true(c->network.dhcp);
	zassert_mem_equal(c->network.ip, ((uint8_t[]){192, 168, 1, 50}), 4);
	zassert_true(c->network.has_dns);
	zassert_str_equal(c->ntp.server, "pool.ntp.org");
	zassert_str_equal(c->mqtt.host, "192.168.1.10");
	zassert_equal(c->mqtt.port, 1883);
	zassert_str_equal(c->mqtt.client_id, "GW01", "empty client_id defaults to edge_node_id");
	zassert_equal(c->mqtt.keepalive_s, 30);
	zassert_str_equal(c->sparkplug.group_id, "Plant1");
	zassert_equal(c->rs485.baud, 9600);
	zassert_equal(c->rs485.parity, GW_PARITY_NONE);
	zassert_equal(c->rs485.retries, 2);
	zassert_equal(c->local_io.di_debounce_ms, 20);

	zassert_equal(c->device_count, 1);
	zassert_equal(c->tag_count, 3);
	zassert_str_equal(c->devices[0].name, "Meter1");
	zassert_equal(c->devices[0].unit_id, 1);
	zassert_equal(c->devices[0].first_tag, 0);
	zassert_equal(c->devices[0].tag_count, 3);

	zassert_str_equal(t[0].name, "Voltage");
	zassert_equal(t[0].area, GW_AREA_INPUT);
	zassert_equal(t[0].type, GW_TYPE_FLOAT32);
	zassert_within(t[0].deadband, 0.1, 1e-12);
	zassert_equal(t[1].type, GW_TYPE_INT16);
	zassert_equal(t[1].word_order, GW_WORD_BIG, "word_order defaults to big");
	zassert_within(t[1].scale, 0.1, 1e-12);
	zassert_true(t[1].writable);
	zassert_equal(t[2].area, GW_AREA_COIL);
	zassert_equal(t[2].type, GW_TYPE_BOOL);
}

ZTEST(config, test_defaults)
{
	const struct gw_config *c = test_config_load(MINIMAL_HEAD "}");

	zassert_true(c->network.dhcp);
	zassert_str_equal(c->ntp.server, "pool.ntp.org");
	zassert_equal(c->mqtt.port, 1883);
	zassert_equal(c->mqtt.keepalive_s, 30);
	zassert_equal(c->rs485.baud, 9600);
	zassert_equal(c->rs485.stop_bits, 1);
	zassert_equal(c->rs485.response_timeout_ms, 200);
	zassert_equal(c->rs485.inter_frame_delay_ms, 5);
	zassert_equal(c->local_io.di_debounce_ms, 20);
	zassert_equal(c->device_count, 0);
}

ZTEST(config, test_static_ip_and_options)
{
	const struct gw_config *c = test_config_load(
		"{\"network\":{\"dhcp\":false,\"ip\":\"10.0.0.2\",\"netmask\":\"255.0.0.0\","
		"\"gateway\":\"10.0.0.1\"},"
		"\"mqtt\":{\"host\":\"b\",\"client_id\":\"cid\",\"username\":\"u\",\"password\":"
		"\"p\\\"w\"},"
		"\"sparkplug\":{\"group_id\":\"G\",\"edge_node_id\":\"N\"},"
		"\"rs485\":{\"baud\":19200,\"parity\":\"even\",\"stop_bits\":2},"
		"\"devices\":[{\"name\":\"M\\u00e9ter\",\"unit_id\":7,\"tags\":["
		"{\"name\":\"E\",\"area\":\"holding\",\"address\":65534,\"type\":\"uint32\","
		"\"word_order\":\"little\"},"
		"{\"name\":\"D\",\"area\":\"discrete\",\"address\":3}]}]}");

	zassert_false(c->network.dhcp);
	zassert_false(c->network.has_dns);
	zassert_mem_equal(c->network.gateway, ((uint8_t[]){10, 0, 0, 1}), 4);
	zassert_str_equal(c->mqtt.client_id, "cid");
	zassert_str_equal(c->mqtt.password, "p\"w", "escapes are decoded");
	zassert_equal(c->rs485.parity, GW_PARITY_EVEN);
	zassert_equal(c->rs485.stop_bits, 2);
	zassert_str_equal(c->devices[0].name, "M\xc3\xa9ter", "\\u escapes become UTF-8");
	zassert_equal(c->tags[0].word_order, GW_WORD_LITTLE);
	zassert_equal(c->tags[1].type, GW_TYPE_BOOL, "bit areas default to bool");
}

struct error_case {
	const char *json;
	const char *expect;
};

ZTEST(config, test_descriptive_errors)
{
	static const struct error_case cases[] = {
		{"", "(root): expected an object, got nothing"},
		{"{\"mqtt\":{\"host\":\"b\",}}", "mqtt: line 1, col 21: trailing comma"},
		{"{\"mqtt\":{\"host\":\"b\"}\n\"x\":1}", "line 2, col 1: expected ',' or '}'"},
		{MINIMAL_HEAD "} x", "unexpected data after the document"},
		{"{\"mqtt\":{\"hots\":\"b\"}}", "mqtt.hots: unknown member"},
		{"{\"foo\":{}}", "foo: unknown member"},
		{"{\"sparkplug\":{\"group_id\":\"G\",\"edge_node_id\":\"N\"}}",
		 "mqtt: section is required"},
		{"{\"mqtt\":{\"host\":\"\"}}", "mqtt.host: must not be empty"},
		{"{\"mqtt\":{\"host\":\"b\",\"port\":70000}}",
		 "mqtt.port: must be between 1 and 65535"},
		{"{\"mqtt\":{\"host\":\"b\",\"port\":\"1883\"}}",
		 "mqtt.port: expected a number, got a string"},
		{"{\"rs485\":{\"baud\":9600.5}}", "rs485.baud: expected an integer"},
		{"{\"rs485\":{\"parity\":\"mark\"}}", "rs485.parity: invalid value 'mark'"},
		{"{\"rs485\":{\"stop_bits\":3}}", "rs485.stop_bits: must be between 1 and 2"},
		{"{\"network\":{\"dhcp\":false,\"ip\":\"10.0.0.2\"}}",
		 "network: 'ip', 'netmask' and 'gateway' are required when dhcp is false"},
		{"{\"network\":{\"ip\":\"192.168.1.300\"}}",
		 "network.ip: invalid IPv4 address '192.168.1.300'"},
		{"{\"mqtt\":{\"host\":\"b\"},\"sparkplug\":{\"group_id\":\"G\",\"edge_node_id\":"
		 "\"a/b\"}}",
		 "sparkplug.edge_node_id: must not contain '/', '+' or '#'"},
		{MINIMAL_HEAD ",\"devices\":[{\"name\":\"D\",\"unit_id\":1,\"tags\":[{\"name\":\"T\","
			      "\"area\":\"holding\",\"type\":\"u16\"}]}]}",
		 "devices[0].tags[0].type: invalid value 'u16'"},
		{MINIMAL_HEAD ",\"devices\":[{\"name\":\"D\",\"unit_id\":1,\"tags\":[{\"name\":\"T\","
			      "\"area\":\"holding\",\"type\":\"bool\"}]}]}",
		 "devices[0].tags[0].type: 'bool' is the only type for coil/discrete"},
		{MINIMAL_HEAD ",\"devices\":[{\"name\":\"D\",\"unit_id\":1,\"tags\":[{\"name\":\"T\","
			      "\"area\":\"coil\",\"type\":\"uint16\"}]}]}",
		 "devices[0].tags[0].type: 'bool' is the only type"},
		{MINIMAL_HEAD ",\"devices\":[{\"name\":\"D\",\"unit_id\":1,\"tags\":[{\"name\":\"T\","
			      "\"area\":\"input\",\"writable\":true}]}]}",
		 "devices[0].tags[0].writable: only coil and holding tags can be writable"},
		{MINIMAL_HEAD ",\"devices\":[{\"name\":\"D\",\"unit_id\":1,\"tags\":[{\"name\":\"T\","
			      "\"area\":\"holding\",\"scale\":0}]}]}",
		 "devices[0].tags[0].scale: must not be zero"},
		{MINIMAL_HEAD ",\"devices\":[{\"name\":\"D\",\"unit_id\":1,\"tags\":[{\"name\":\"T\","
			      "\"area\":\"holding\",\"type\":\"uint32\",\"address\":65535}]}]}",
		 "devices[0].tags[0].address: register range exceeds 65535"},
		{MINIMAL_HEAD ",\"devices\":[{\"name\":\"D\",\"unit_id\":1,\"tags\":[{\"name\":\"T\","
			      "\"area\":\"holding\"},{\"name\":\"T\",\"area\":\"input\"}]}]}",
		 "devices[0].tags[1].name: duplicate tag name 'T'"},
		{MINIMAL_HEAD ",\"devices\":[{\"name\":\"D\",\"unit_id\":1,\"tags\":[{\"name\":\"T\","
			      "\"area\":\"holding\"}]},{\"name\":\"E\",\"unit_id\":1,\"tags\":[{\"name\":"
			      "\"T\",\"area\":\"holding\"}]}]}",
		 "devices[1].unit_id: unit_id 1 already used by 'D'"},
		{MINIMAL_HEAD ",\"devices\":[{\"name\":\"D\",\"unit_id\":1,\"tags\":[]}]}",
		 "devices[0].tags: at least one tag is required"},
		{MINIMAL_HEAD ",\"devices\":[{\"name\":\"D\",\"tags\":[{\"name\":\"T\","
			      "\"area\":\"holding\"}]}]}",
		 "devices[0].unit_id: is required"},
		{MINIMAL_HEAD ",\"devices\":[{\"name\":\"D\",\"unit_id\":1,\"tags\":[{\"name\":\"T\""
			      "}]}]}",
		 "devices[0].tags[0].area: is required"},
		{MINIMAL_HEAD ",\"devices\":[{\"name\":\"0123456789012345678901234567890123\"}]}",
		 "devices[0].name: line 1, col 128: string too long (max 32 bytes)"},
		{"{\"mqtt\":{\"host\":\"\\q\"}}", "invalid escape sequence"},
		{"{\"mqtt\":{\"host\":\"\\ud800\"}}", "unpaired UTF-16 surrogate"},
		{"{\"rs485\":{\"retries\":01}}", "rs485: line 1, col 22: expected ',' or '}'"},
		{"{\"rs485\":{\"baud\":-}}", "rs485.baud: line 1, col 18: invalid number"},
	};

	int failures = 0;

	for (size_t i = 0; i < ARRAY_SIZE(cases); i++) {
		const char *err = test_config_error(cases[i].json);

		if (strstr(err, cases[i].expect) == NULL) {
			printk("case %u: got \"%s\", want \"%s\"\n", (unsigned int)i, err,
			       cases[i].expect);
			failures++;
		}
	}
	zassert_equal(failures, 0, "%d error message(s) differ", failures);
}

/* Build a document with @p devices devices of @p tags tags each. */
static const char *build_doc(int devices, int tags)
{
	static char doc[96 * 1024];
	size_t n = 0;

	n += snprintf(&doc[n], sizeof(doc) - n, MINIMAL_HEAD ",\"devices\":[");
	for (int d = 0; d < devices; d++) {
		n += snprintf(&doc[n], sizeof(doc) - n, "%s{\"name\":\"D%d\",\"unit_id\":%d,\"tags\":[",
			      d ? "," : "", d, d + 1);
		for (int t = 0; t < tags; t++) {
			n += snprintf(&doc[n], sizeof(doc) - n,
				      "%s{\"name\":\"T%d\",\"area\":\"holding\",\"address\":%d}",
				      t ? "," : "", t, t);
		}
		n += snprintf(&doc[n], sizeof(doc) - n, "]}");
	}
	snprintf(&doc[n], sizeof(doc) - n, "]}");
	return doc;
}

ZTEST(config, test_limits)
{
	const struct gw_config *c;

	c = test_config_load(build_doc(4, CONFIG_GW_MAX_TAGS_PER_DEVICE));
	zassert_equal(c->tag_count, CONFIG_GW_MAX_TAGS, "exactly at the total limit");
	zassert_equal(c->devices[3].first_tag, 3 * CONFIG_GW_MAX_TAGS_PER_DEVICE);

	zassert_not_null(strstr(test_config_error(build_doc(1, CONFIG_GW_MAX_TAGS_PER_DEVICE + 1)),
				"devices[0].tags: too many tags (max 64 per device)"));
	zassert_not_null(strstr(test_config_error(build_doc(5, CONFIG_GW_MAX_TAGS_PER_DEVICE)),
				"devices[4].tags: too many tags (max 256 in total)"));
	zassert_not_null(strstr(test_config_error(build_doc(CONFIG_GW_MAX_DEVICES + 1, 1)),
				"too many devices (max 16)"));
}

ZTEST_SUITE(config, NULL, NULL, NULL, NULL, NULL);
```

## src/test_convert.c
```c
/*
 * Register/value conversion, word order and scaling (MB-5, MB-7) and the
 * Sparkplug datatype mapping of SPEC section 6.
 *
 * SPDX-License-Identifier: Apache-2.0
 */

#include <errno.h>
#include <math.h>

#include <zephyr/ztest.h>

#include "convert.h"
#include "sparkplug.h"

static struct gw_tag_cfg tag(enum gw_area area, enum gw_type type, enum gw_word_order wo,
			     double scale, double offset)
{
	return (struct gw_tag_cfg){
		.area = area, .type = type, .word_order = wo, .scale = scale, .offset = offset};
}

ZTEST(convert, test_decode_16bit)
{
	struct gw_tag_cfg t = tag(GW_AREA_HOLDING, GW_TYPE_INT16, GW_WORD_BIG, 1, 0);

	zassert_equal(gw_regs_to_value(&t, (uint16_t[]){0xFFFE, 0}), -2.0);
	t.type = GW_TYPE_UINT16;
	zassert_equal(gw_regs_to_value(&t, (uint16_t[]){0xFFFE, 0}), 65534.0);
	t = tag(GW_AREA_COIL, GW_TYPE_BOOL, GW_WORD_BIG, 1, 0);
	zassert_equal(gw_regs_to_value(&t, (uint16_t[]){1, 0}), 1.0);
}

ZTEST(convert, test_decode_32bit_word_order)
{
	struct gw_tag_cfg t = tag(GW_AREA_INPUT, GW_TYPE_UINT32, GW_WORD_BIG, 1, 0);

	zassert_equal(gw_regs_to_value(&t, (uint16_t[]){0x1234, 0x5678}), (double)0x12345678);
	t.word_order = GW_WORD_LITTLE;
	zassert_equal(gw_regs_to_value(&t, (uint16_t[]){0x5678, 0x1234}), (double)0x12345678);

	t.type = GW_TYPE_INT32;
	zassert_equal(gw_regs_to_value(&t, (uint16_t[]){0xFFFF, 0xFFFF}), -1.0);
	zassert_equal(gw_regs_to_value(&t, (uint16_t[]){0x0000, 0x8000}), -2147483648.0);

	t = tag(GW_AREA_INPUT, GW_TYPE_FLOAT32, GW_WORD_BIG, 1, 0);
	zassert_equal(gw_regs_to_value(&t, (uint16_t[]){0x4366, 0x8000}), 230.5);
	t.word_order = GW_WORD_LITTLE;
	zassert_equal(gw_regs_to_value(&t, (uint16_t[]){0x8000, 0x4366}), 230.5);
}

ZTEST(convert, test_scale_offset)
{
	struct gw_tag_cfg t = tag(GW_AREA_HOLDING, GW_TYPE_INT16, GW_WORD_BIG, 0.1, 0);

	zassert_within(gw_regs_to_value(&t, (uint16_t[]){123, 0}), 12.3, 1e-9);
	zassert_within(gw_regs_to_value(&t, (uint16_t[]){(uint16_t)-123, 0}), -12.3, 1e-9);
	t = tag(GW_AREA_INPUT, GW_TYPE_UINT16, GW_WORD_BIG, 0.5, -40);
	zassert_within(gw_regs_to_value(&t, (uint16_t[]){100, 0}), 10.0, 1e-9);
}

ZTEST(convert, test_inverse_for_writes)
{
	struct gw_tag_cfg t = tag(GW_AREA_HOLDING, GW_TYPE_INT16, GW_WORD_BIG, 0.1, 0);
	uint16_t regs[2] = {0};

	/* SPEC 7.4: Setpoint=12.3 must write 123 (also from a float32 12.3f). */
	zassert_ok(gw_value_to_regs(&t, 12.3, regs));
	zassert_equal(regs[0], 123);
	zassert_ok(gw_value_to_regs(&t, (double)12.3f, regs));
	zassert_equal(regs[0], 123);
	zassert_ok(gw_value_to_regs(&t, -12.3, regs));
	zassert_equal(regs[0], (uint16_t)-123);
	zassert_equal(gw_value_to_regs(&t, 3276.8, regs), -ERANGE);
	zassert_equal(gw_value_to_regs(&t, NAN, regs), -ERANGE);

	t = tag(GW_AREA_HOLDING, GW_TYPE_UINT16, GW_WORD_BIG, 1, 0);
	zassert_equal(gw_value_to_regs(&t, -1, regs), -ERANGE);
	zassert_ok(gw_value_to_regs(&t, 65535, regs));
	zassert_equal(regs[0], 65535);

	t = tag(GW_AREA_HOLDING, GW_TYPE_UINT32, GW_WORD_LITTLE, 1, 0);
	zassert_ok(gw_value_to_regs(&t, (double)0x12345678, regs));
	zassert_equal(regs[0], 0x5678);
	zassert_equal(regs[1], 0x1234);

	t = tag(GW_AREA_HOLDING, GW_TYPE_INT32, GW_WORD_BIG, 1, 0);
	zassert_ok(gw_value_to_regs(&t, -2, regs));
	zassert_equal(regs[0], 0xFFFF);
	zassert_equal(regs[1], 0xFFFE);
	zassert_equal(gw_value_to_regs(&t, 2147483648.0, regs), -ERANGE);

	t = tag(GW_AREA_HOLDING, GW_TYPE_FLOAT32, GW_WORD_BIG, 2, 1);
	zassert_ok(gw_value_to_regs(&t, 462.0, regs)); /* raw 230.5 */
	zassert_equal(regs[0], 0x4366);
	zassert_equal(regs[1], 0x8000);
	zassert_equal(gw_value_to_regs(&t, 1e300, regs), -ERANGE);

	t = tag(GW_AREA_COIL, GW_TYPE_BOOL, GW_WORD_BIG, 1, 0);
	zassert_ok(gw_value_to_regs(&t, 1.0, regs));
	zassert_equal(regs[0], 1);
	zassert_ok(gw_value_to_regs(&t, 0.0, regs));
	zassert_equal(regs[0], 0);
}

ZTEST(convert, test_round_trip)
{
	static const enum gw_type types[] = {GW_TYPE_UINT16, GW_TYPE_INT16, GW_TYPE_UINT32,
					     GW_TYPE_INT32, GW_TYPE_FLOAT32};
	static const double values[] = {0, 1, 100, 1234.5, -7.25};

	for (size_t i = 0; i < ARRAY_SIZE(types); i++) {
		for (int wo = GW_WORD_BIG; wo <= GW_WORD_LITTLE; wo++) {
			struct gw_tag_cfg t = tag(GW_AREA_HOLDING, types[i], wo, 0.25, 3);

			for (size_t v = 0; v < ARRAY_SIZE(values); v++) {
				uint16_t regs[2];
				bool unsigned_neg = (types[i] == GW_TYPE_UINT16 ||
						     types[i] == GW_TYPE_UINT32) &&
						    values[v] < 3;

				if (unsigned_neg) {
					continue;
				}
				zassert_ok(gw_value_to_regs(&t, values[v], regs));
				zassert_within(gw_regs_to_value(&t, regs), values[v], 1e-9,
					       "type %d wo %d value %f", types[i], wo, values[v]);
			}
		}
	}
}

ZTEST(convert, test_datatype_mapping)
{
	struct gw_tag_cfg t = tag(GW_AREA_COIL, GW_TYPE_BOOL, GW_WORD_BIG, 1, 0);

	zassert_equal(gw_tag_datatype(&t), SPB_DT_BOOLEAN);
	t = tag(GW_AREA_HOLDING, GW_TYPE_INT16, GW_WORD_BIG, 1, 0);
	zassert_equal(gw_tag_datatype(&t), SPB_DT_INT16);
	t.type = GW_TYPE_UINT16;
	zassert_equal(gw_tag_datatype(&t), SPB_DT_UINT16);
	t.type = GW_TYPE_INT32;
	zassert_equal(gw_tag_datatype(&t), SPB_DT_INT32);
	t.type = GW_TYPE_UINT32;
	zassert_equal(gw_tag_datatype(&t), SPB_DT_UINT32);
	t.type = GW_TYPE_FLOAT32;
	zassert_equal(gw_tag_datatype(&t), SPB_DT_FLOAT);
	t = tag(GW_AREA_HOLDING, GW_TYPE_INT16, GW_WORD_BIG, 0.1, 0);
	zassert_equal(gw_tag_datatype(&t), SPB_DT_FLOAT, "scaled -> Float");
	t = tag(GW_AREA_HOLDING, GW_TYPE_UINT32, GW_WORD_BIG, 1, -5);
	zassert_equal(gw_tag_datatype(&t), SPB_DT_FLOAT, "offset -> Float");
}

ZTEST_SUITE(convert, NULL, NULL, NULL, NULL, NULL);
```

## src/test_debounce.c
```c
/*
 * Digital input debouncing (IO-1).
 *
 * SPDX-License-Identifier: Apache-2.0
 */

#include <zephyr/ztest.h>

#include "debounce.h"

static uint8_t feed(struct debounce *db, uint8_t raw, int samples)
{
	uint8_t flipped = 0;

	for (int i = 0; i < samples; i++) {
		flipped |= debounce_step(db, raw);
	}
	return flipped;
}

ZTEST(debounce, test_glitch_rejected)
{
	struct debounce db;

	debounce_init(&db, 0x00, 20);
	zassert_equal(feed(&db, 0x04, 19), 0, "19 ms glitch must be ignored");
	zassert_equal(feed(&db, 0x00, 1), 0);
	zassert_equal(db.state, 0x00);
}

ZTEST(debounce, test_stable_change_accepted)
{
	struct debounce db;

	debounce_init(&db, 0x00, 20);
	zassert_equal(feed(&db, 0x04, 19), 0);
	zassert_equal(debounce_step(&db, 0x04), 0x04, "accepted on the 20th sample");
	zassert_equal(db.state, 0x04);
	zassert_equal(feed(&db, 0x04, 100), 0, "no repeated events");
	zassert_equal(feed(&db, 0x00, 20), 0x04);
	zassert_equal(db.state, 0x00);
}

ZTEST(debounce, test_channels_independent)
{
	struct debounce db;

	debounce_init(&db, 0xF0, 5);
	zassert_equal(feed(&db, 0xF1, 3), 0);
	zassert_equal(feed(&db, 0x71, 2), 0x01, "bit 0 completes, bit 7 just started");
	zassert_equal(feed(&db, 0x71, 3), 0x80);
	zassert_equal(db.state, 0x71);
}

ZTEST(debounce, test_zero_means_immediate)
{
	struct debounce db;

	debounce_init(&db, 0x00, 0);
	zassert_equal(debounce_step(&db, 0xFF), 0xFF);
	zassert_equal(debounce_step(&db, 0x00), 0xFF);
}

ZTEST_SUITE(debounce, NULL, NULL, NULL, NULL, NULL);
```

## src/test_rbe.c
```c
/*
 * Report by exception and deadband (SPB-7, SPB-12).
 *
 * SPDX-License-Identifier: Apache-2.0
 */

#include <math.h>

#include <zephyr/ztest.h>

#include "model.h"
#include "test_util.h"

ZTEST(rbe, test_exceeds)
{
	struct gw_tag_cfg analog = {.type = GW_TYPE_FLOAT32, .scale = 1, .deadband = 0.1};
	struct gw_tag_cfg plain = {.type = GW_TYPE_UINT16, .scale = 1};
	struct gw_tag_cfg bit = {.type = GW_TYPE_BOOL, .scale = 1, .deadband = 5};

	zassert_false(model_rbe_exceeds(&analog, 230.0, 230.05));
	zassert_false(model_rbe_exceeds(&analog, 230.0, 230.0));
	zassert_false(model_rbe_exceeds(&analog, 230.0, 230.0 + 0.1), "equal to the band");
	zassert_true(model_rbe_exceeds(&analog, 230.0, 230.11));
	zassert_true(model_rbe_exceeds(&analog, 230.0, 229.8), "both directions");
	zassert_true(model_rbe_exceeds(&analog, 230.0, NAN));
	zassert_true(model_rbe_exceeds(&analog, NAN, 230.0));
	zassert_false(model_rbe_exceeds(&analog, NAN, NAN));

	zassert_false(model_rbe_exceeds(&plain, 7, 7));
	zassert_true(model_rbe_exceeds(&plain, 7, 8), "no deadband: any change");
	zassert_true(model_rbe_exceeds(&bit, 0, 1), "deadband ignored for bool");
}

static void *setup(void)
{
	return NULL;
}

static void before(void *f)
{
	ARG_UNUSED(f);
	model_init(test_config_load(spec_config_json));
}

ZTEST(rbe_store, test_pending_tracking)
{
	struct gw_tag_state *st = model_tag(0);

	model_tag_store(0, 230.0, 1, false);
	zassert_true(st->pending, "first value is always reported");
	/* What spb_node does when it publishes: */
	st->reported = st->value;
	st->pending = false;

	model_tag_store(0, 230.05, 2, false);
	zassert_false(st->pending, "inside the deadband");
	model_tag_store(0, 230.08, 3, false);
	zassert_false(st->pending, "drift is measured from the last report");
	model_tag_store(0, 230.2, 4, false);
	zassert_true(st->pending);
	zassert_equal(st->ts_ms, 4);
	zassert_within(st->value, 230.2, 1e-12);

	st->reported = st->value;
	st->pending = false;
	model_tag_store(0, 230.2, 5, true);
	zassert_true(st->pending, "write confirmations are always reported");
}

ZTEST_SUITE(rbe, NULL, NULL, NULL, NULL, NULL);
ZTEST_SUITE(rbe_store, NULL, setup, before, NULL, NULL);
```

## src/test_sparkplug.c
```c
/*
 * Sparkplug B payload codec and topics (SPB-1).
 *
 * SPDX-License-Identifier: Apache-2.0
 */

#include <errno.h>
#include <string.h>

#include <zephyr/ztest.h>

#include "sparkplug.h"

static const struct spb_metric sample[] = {
	{.name = "b", .has_alias = true, .alias = 1, .has_datatype = true,
	 .datatype = SPB_DT_BOOLEAN, .timestamp = 1700000000000ULL, .v.b = true},
	{.name = "i16", .has_alias = true, .alias = 2, .has_datatype = true,
	 .datatype = SPB_DT_INT16, .v.i = -5},
	{.name = "u32", .has_alias = true, .alias = 3, .has_datatype = true,
	 .datatype = SPB_DT_UINT32, .v.u = 0xFFFFFFF0u},
	{.name = "f", .has_alias = true, .alias = 4, .has_datatype = true,
	 .datatype = SPB_DT_FLOAT, .v.d = 12.3},
	{.name = "d", .has_alias = true, .alias = 5, .has_datatype = true,
	 .datatype = SPB_DT_DOUBLE, .v.d = -1.5e10},
	{.name = "s", .has_alias = true, .alias = 6, .has_datatype = true,
	 .datatype = SPB_DT_STRING, .v.s = "0.1.0+abc"},
	{.name = "u64", .has_alias = true, .alias = 7, .has_datatype = true,
	 .datatype = SPB_DT_UINT64, .v.u = 255},
	{.name = NULL, .has_alias = true, .alias = 1000, .datatype = SPB_DT_FLOAT, .v.d = 1.0},
	{.name = "null", .has_alias = true, .alias = 8, .has_datatype = true,
	 .datatype = SPB_DT_INT32, .is_null = true},
};

static int get_sample(void *ctx, size_t i, struct spb_metric *m)
{
	ARG_UNUSED(ctx);
	*m = sample[i];
	return 0;
}

static struct spb_metric_in decoded[ARRAY_SIZE(sample) + 1];
static size_t n_decoded;

static void collect(void *ctx, const struct spb_metric_in *m)
{
	ARG_UNUSED(ctx);
	if (n_decoded < ARRAY_SIZE(decoded)) {
		decoded[n_decoded] = *m;
	}
	n_decoded++;
}

static void before(void *f)
{
	ARG_UNUSED(f);
	n_decoded = 0;
	memset(decoded, 0, sizeof(decoded));
}

ZTEST(sparkplug, test_round_trip)
{
	struct spb_payload_out p = {.timestamp = 1700000000123ULL, .has_seq = true, .seq = 42,
				    .metric_count = ARRAY_SIZE(sample), .get = get_sample};
	uint8_t buf[512];
	size_t len;
	double v;

	zassert_ok(spb_encode(&p, buf, sizeof(buf), &len));
	zassert_ok(spb_decode(buf, len, collect, NULL));
	zassert_equal(n_decoded, ARRAY_SIZE(sample));

	zassert_str_equal(decoded[0].name, "b");
	zassert_equal(decoded[0].kind, SPB_VAL_BOOL);
	zassert_true(decoded[0].v.b);
	zassert_equal(decoded[0].datatype, SPB_DT_BOOLEAN);

	/* Int16 travels as the 32-bit two's complement in int_value. */
	zassert_equal(decoded[1].kind, SPB_VAL_INT);
	zassert_equal(decoded[1].v.i, 0xFFFFFFFBu);
	zassert_ok(spb_metric_in_number(&decoded[1], SPB_DT_INT16, &v));
	zassert_equal(v, -5.0);

	zassert_ok(spb_metric_in_number(&decoded[2], SPB_DT_UINT32, &v));
	zassert_equal(v, (double)0xFFFFFFF0u);
	zassert_equal(decoded[3].kind, SPB_VAL_FLOAT);
	zassert_within((double)decoded[3].v.f, 12.3, 1e-6);
	zassert_equal(decoded[4].kind, SPB_VAL_DOUBLE);
	zassert_equal(decoded[4].v.d, -1.5e10);
	zassert_equal(decoded[5].kind, SPB_VAL_STRING);
	zassert_str_equal(decoded[5].v.s, "0.1.0+abc");
	zassert_equal(decoded[6].kind, SPB_VAL_LONG);
	zassert_equal(decoded[6].v.l, 255);

	zassert_false(decoded[7].has_name, "DATA metrics travel by alias only");
	zassert_false(decoded[7].has_datatype);
	zassert_equal(decoded[7].alias, 1000);

	zassert_true(decoded[8].is_null);
	zassert_equal(decoded[8].kind, SPB_VAL_NONE);
	zassert_equal(spb_metric_in_number(&decoded[8], SPB_DT_INT32, &v), -EINVAL);
}

static int get_ctx(void *ctx, size_t i, struct spb_metric *m)
{
	ARG_UNUSED(i);
	*m = *(const struct spb_metric *)ctx;
	return 0;
}

ZTEST(sparkplug, test_encode_limits)
{
	static const struct spb_metric long_name = {
		.name = "0123456789012345678901234567890123456789012345678901234567890123",
		.datatype = SPB_DT_BOOLEAN};
	static const struct spb_metric long_string = {
		.name = "s", .datatype = SPB_DT_STRING,
		.v.s = "0123456789012345678901234567890123456789012345678901234567890123"};
	struct spb_payload_out p = {.has_seq = true, .metric_count = ARRAY_SIZE(sample),
				    .get = get_sample};
	uint8_t buf[512];
	size_t len;

	zassert_equal(spb_encode(&p, buf, 40, &len), -ENOMEM, "buffer too small");

	p.metric_count = 0;
	zassert_ok(spb_encode(&p, buf, sizeof(buf), &len), "payload without metrics (DDEATH)");

	p = (struct spb_payload_out){.metric_count = 1, .get = get_ctx, .ctx = (void *)&long_name};
	zassert_equal(spb_encode(&p, buf, sizeof(buf), &len), -EINVAL, "64-byte name");
	p.ctx = (void *)&long_string;
	zassert_equal(spb_encode(&p, buf, sizeof(buf), &len), -EINVAL, "64-byte string");
}

ZTEST(sparkplug, test_decode_malformed)
{
	static const uint8_t garbage[] = {0x12, 0x40, 0x0a, 0x01}; /* truncated metric */

	zassert_equal(spb_decode(garbage, sizeof(garbage), collect, NULL), -EINVAL);
}

ZTEST(sparkplug, test_topics)
{
	char buf[64];
	char dev[33];

	zassert_true(spb_topic(buf, sizeof(buf), "Plant1", "NBIRTH", "GW01", NULL) > 0);
	zassert_str_equal(buf, "spBv1.0/Plant1/NBIRTH/GW01");
	zassert_true(spb_topic(buf, sizeof(buf), "Plant1", "DDATA", "GW01", "Meter1") > 0);
	zassert_str_equal(buf, "spBv1.0/Plant1/DDATA/GW01/Meter1");
	zassert_equal(spb_topic(buf, 10, "Plant1", "DDATA", "GW01", "Meter1"), -ENOMEM);

#define PARSE(t) spb_topic_parse_cmd(t, strlen(t), "Plant1", "GW01", dev, sizeof(dev))
	zassert_equal(PARSE("spBv1.0/Plant1/NCMD/GW01"), SPB_CMD_NODE);
	zassert_equal(PARSE("spBv1.0/Plant1/DCMD/GW01/Meter1"), SPB_CMD_DEVICE);
	zassert_str_equal(dev, "Meter1");
	zassert_equal(PARSE("spBv1.0/Plant1/NCMD/GW01/"), -EINVAL);
	zassert_equal(PARSE("spBv1.0/Plant1/NCMD/GW011"), -EINVAL);
	zassert_equal(PARSE("spBv1.0/Plant1/NCMD/GW0"), -EINVAL);
	zassert_equal(PARSE("spBv1.0/Plant2/NCMD/GW01"), -EINVAL);
	zassert_equal(PARSE("spBv1.0/Plant1/NDATA/GW01"), -EINVAL);
	zassert_equal(PARSE("spBv1.0/Plant1/DCMD/GW01"), -EINVAL);
	zassert_equal(PARSE("spBv1.0/Plant1/DCMD/GW01/"), -EINVAL);
	zassert_equal(PARSE("spBv1.0/Plant1/DCMD/GW01/a/b"), -EINVAL);
	zassert_equal(PARSE("spBv1.0/STATE/host"), -EINVAL);
#undef PARSE
}

ZTEST_SUITE(sparkplug, NULL, NULL, before, NULL, NULL);
```

## src/test_spb_node.c
```c
/*
 * Sparkplug edge node behaviour (SPB-2..SPB-11) with fake transport,
 * Modbus and I/O. Each published payload is also printed as
 * "SPB_SAMPLE <topic> <hex>" so scripts/decode_samples.py can check it
 * against the official proto with Python protobuf.
 *
 * SPDX-License-Identifier: Apache-2.0
 */

#include <stdio.h>
#include <string.h>

#include <zephyr/ztest.h>

#include "convert.h"
#include "model.h"
#include "sparkplug.h"
#include "spb_node.h"
#include "test_util.h"

#define MAX_MSGS 16

struct msg {
	char topic[128];
	uint8_t data[1024];
	size_t len;
	uint8_t qos;
};

static struct msg msgs[MAX_MSGS];
static size_t n_msgs;
static int64_t now;
static int writes;
static struct {
	uint8_t dev;
	uint16_t tag;
	double value;
} last_write;
static int outputs_set;
static bool quiet; /* suppress SPB_SAMPLE output in bulk tests */

static void dump(const struct msg *m)
{
	char hex[2 * sizeof(m->data) + 1];

	for (size_t i = 0; i < m->len; i++) {
		snprintf(&hex[2 * i], 3, "%02x", m->data[i]);
	}
	hex[2 * m->len] = '\0';
	printk("SPB_SAMPLE %s %s\n", m->topic, hex);
}

static int fake_publish(const char *topic, const uint8_t *payload, size_t len, uint8_t qos)
{
	struct msg *m = &msgs[n_msgs % MAX_MSGS];

	zassert_true(len <= sizeof(m->data));
	strncpy(m->topic, topic, sizeof(m->topic) - 1);
	memcpy(m->data, payload, len);
	m->len = len;
	m->qos = qos;
	n_msgs++;
	if (!quiet) {
		dump(m);
	}
	return 0;
}

static int fake_write(uint8_t dev, uint16_t tag, double value)
{
	writes++;
	last_write.dev = dev;
	last_write.tag = tag;
	last_write.value = value;
	return 0;
}

static int fake_set_output(uint8_t channel, bool on)
{
	outputs_set++;
	model_lock();
	WRITE_BIT(model_io()->outputs, channel, on);
	model_io()->do_ts_ms = now;
	model_unlock();
	model_signal_node();
	return 0;
}

static int64_t fake_now(void)
{
	return now;
}

static const struct spb_node_ops ops = {
	.publish = fake_publish,
	.write_tag = fake_write,
	.set_output = fake_set_output,
	.now_ms = fake_now,
};

/* ---- helpers ------------------------------------------------------------ */

struct decoded {
	size_t n;
	struct spb_metric_in m[24];
};

static void collect(void *ctx, const struct spb_metric_in *m)
{
	struct decoded *d = ctx;

	if (d->n < ARRAY_SIZE(d->m)) {
		d->m[d->n] = *m;
	}
	d->n++;
}

static const struct msg *last(void)
{
	zassert_true(n_msgs > 0);
	return &msgs[(n_msgs - 1) % MAX_MSGS];
}

/* Decode a message and return its seq (-1 when absent). */
static int decode(const struct msg *m, struct decoded *d)
{
	int seq = -1;
	const uint8_t *p = m->data;

	memset(d, 0, sizeof(*d));
	zassert_ok(spb_decode(m->data, m->len, collect, d));
	/* seq is field 3 (varint): scan the top level for it. */
	for (size_t i = 0; i < m->len;) {
		uint8_t key = p[i++];
		uint64_t v = 0;
		int shift = 0;

		if ((key & 7) == 0) {
			do {
				v |= (uint64_t)(p[i] & 0x7f) << shift;
				shift += 7;
			} while (p[i++] & 0x80);
			if ((key >> 3) == 3) {
				seq = (int)v;
			}
		} else if ((key & 7) == 2) {
			uint64_t l = 0;

			shift = 0;
			do {
				l |= (uint64_t)(p[i] & 0x7f) << shift;
				shift += 7;
			} while (p[i++] & 0x80);
			i += l;
		} else {
			break;
		}
	}
	return seq;
}

static const struct spb_metric_in *find(const struct decoded *d, const char *name,
					uint64_t alias)
{
	for (size_t i = 0; i < d->n; i++) {
		if ((name && d->m[i].has_name && strcmp(d->m[i].name, name) == 0) ||
		    (!name && d->m[i].has_alias && d->m[i].alias == alias)) {
			return &d->m[i];
		}
	}
	return NULL;
}

/* Encode a single-metric command and hand it to the node. */
static struct spb_metric cmd_metric;

static int get_cmd_metric(void *ctx, size_t i, struct spb_metric *out)
{
	ARG_UNUSED(ctx);
	ARG_UNUSED(i);
	*out = cmd_metric;
	return 0;
}

static void send_cmd(const char *topic, struct spb_metric m)
{
	struct spb_payload_out p = {.timestamp = 1, .metric_count = 1, .get = get_cmd_metric};
	uint8_t buf[128];
	size_t len;

	cmd_metric = m;
	zassert_ok(spb_encode(&p, buf, sizeof(buf), &len));
	spb_node_on_command(topic, strlen(topic), buf, len);
}

static void device_online(uint8_t dev, double voltage)
{
	model_lock();
	model_tag_store(0, voltage, now, false);
	model_tag_store(1, 12.0, now, false);
	model_tag_store(2, 0.0, now, false);
	model_dev(dev)->online = true;
	model_dev(dev)->generation++;
	model_unlock();
	model_signal_device(dev);
}

static void store(uint16_t tag, double value)
{
	model_lock();
	model_tag_store(tag, value, ++now, false);
	model_unlock();
	model_signal_device(0);
}

/* ---- fixture ------------------------------------------------------------ */

static void before(void *f)
{
	const struct gw_config *cfg = test_config_load(spec_config_json);

	ARG_UNUSED(f);
	memset(msgs, 0, sizeof(msgs));
	n_msgs = 0;
	writes = 0;
	outputs_set = 0;
	quiet = false;
	now = 1700000000000LL;
	model_init(cfg);
	spb_node_init(cfg, &ops, "0.1.0+test", "Test HW");
}

/* ---- tests -------------------------------------------------------------- */

ZTEST(spb_node, test_birth_sequence)
{
	struct decoded d;
	const struct spb_metric_in *m;

	spb_node_session_start(7);
	zassert_equal(spb_node_service(), SPB_NODE_REQ_NONE);
	zassert_equal(n_msgs, 1, "offline device: only NBIRTH");
	zassert_str_equal(last()->topic, "spBv1.0/Plant1/NBIRTH/GW01");
	zassert_equal(last()->qos, 0);
	zassert_equal(decode(last(), &d), 0, "NBIRTH seq is 0");
	zassert_equal(d.n, 21);
	m = find(&d, "bdSeq", 0);
	zassert_not_null(m);
	zassert_equal(m->datatype, SPB_DT_UINT64);
	zassert_equal(m->v.l, 7, "NBIRTH carries the will's bdSeq");
	m = find(&d, "Node Control/Rebirth", 0);
	zassert_true(m && m->kind == SPB_VAL_BOOL && !m->v.b);
	zassert_not_null(find(&d, "Node Control/Reboot", 0));
	zassert_str_equal(find(&d, "Node Info/Firmware", 0)->v.s, "0.1.0+test");
	zassert_str_equal(find(&d, "Node Info/Hardware", 0)->v.s, "Test HW");
	zassert_equal(find(&d, "DI/1", 0)->alias, SPB_ALIAS_DI_BASE);
	zassert_equal(find(&d, "DO/8", 0)->alias, SPB_ALIAS_DO_BASE + 7);
	for (size_t i = 0; i < d.n; i++) {
		zassert_true(d.m[i].has_name && d.m[i].has_alias && d.m[i].has_datatype &&
			     d.m[i].kind != SPB_VAL_NONE, "metric %u incomplete", i);
	}

	device_online(0, 230.0);
	zassert_equal(spb_node_service(), SPB_NODE_REQ_NONE);
	zassert_str_equal(last()->topic, "spBv1.0/Plant1/DBIRTH/GW01/Meter1");
	zassert_equal(decode(last(), &d), 1);
	zassert_equal(d.n, 3);
	m = find(&d, "Voltage", 0);
	zassert_true(m && m->alias == SPB_ALIAS_TAG_BASE && m->datatype == SPB_DT_FLOAT);
	zassert_within((double)m->v.f, 230.0, 1e-3);
	m = find(&d, "Setpoint", 0);
	zassert_true(m && m->datatype == SPB_DT_FLOAT && m->alias == SPB_ALIAS_TAG_BASE + 1);
	m = find(&d, "Run", 0);
	zassert_true(m && m->datatype == SPB_DT_BOOLEAN && !m->v.b);

	zassert_equal(spb_node_service(), SPB_NODE_REQ_NONE);
	zassert_equal(n_msgs, 2, "nothing changed: nothing published");
}

ZTEST(spb_node, test_report_by_exception)
{
	struct decoded d;

	spb_node_session_start(0);
	device_online(0, 230.0);
	(void)spb_node_service();
	zassert_equal(n_msgs, 2);

	store(0, 230.05);
	store(2, 0.0);
	(void)spb_node_service();
	zassert_equal(n_msgs, 2, "inside the deadband / unchanged: no DDATA");

	store(0, 230.3);
	store(2, 1.0);
	(void)spb_node_service();
	zassert_equal(n_msgs, 3);
	zassert_str_equal(last()->topic, "spBv1.0/Plant1/DDATA/GW01/Meter1");
	zassert_equal(decode(last(), &d), 2);
	zassert_equal(d.n, 2, "one message for the cycle, changed metrics only");
	for (size_t i = 0; i < d.n; i++) {
		zassert_false(d.m[i].has_name, "DATA metrics carry no name");
	}
	zassert_within((double)find(&d, NULL, SPB_ALIAS_TAG_BASE)->v.f, 230.3, 1e-3);
	zassert_true(find(&d, NULL, SPB_ALIAS_TAG_BASE + 2)->v.b);
}

ZTEST(spb_node, test_device_death_and_rebirth)
{
	struct decoded d;

	spb_node_session_start(0);
	device_online(0, 230.0);
	(void)spb_node_service();

	model_lock();
	model_dev(0)->online = false;
	model_unlock();
	model_signal_device(0);
	(void)spb_node_service();
	zassert_str_equal(last()->topic, "spBv1.0/Plant1/DDEATH/GW01/Meter1");
	zassert_equal(decode(last(), &d), 2, "DDEATH takes the next seq");

	device_online(0, 231.0);
	(void)spb_node_service();
	zassert_str_equal(last()->topic, "spBv1.0/Plant1/DBIRTH/GW01/Meter1");
	zassert_equal(decode(last(), &d), 3);
}

ZTEST(spb_node, test_ncmd_rebirth)
{
	struct decoded d;

	spb_node_session_start(5);
	device_online(0, 230.0);
	(void)spb_node_service();
	store(0, 240.0);
	(void)spb_node_service();
	zassert_equal(n_msgs, 3);

	send_cmd("spBv1.0/Plant1/NCMD/GW01", (struct spb_metric){
		.name = "Node Control/Rebirth", .has_datatype = true,
		.datatype = SPB_DT_BOOLEAN, .v.b = true});
	(void)spb_node_service();
	zassert_equal(n_msgs, 5, "NBIRTH and DBIRTH again");
	zassert_str_equal(msgs[3].topic, "spBv1.0/Plant1/NBIRTH/GW01");
	zassert_equal(decode(&msgs[3], &d), 0, "seq restarts at 0");
	zassert_equal(find(&d, "bdSeq", 0)->v.l, 5, "same bdSeq on rebirth");
	zassert_str_equal(msgs[4].topic, "spBv1.0/Plant1/DBIRTH/GW01/Meter1");
	zassert_equal(decode(&msgs[4], &d), 1);
	zassert_within((double)find(&d, "Voltage", 0)->v.f, 240.0, 1e-3, "current values");
}

ZTEST(spb_node, test_seq_wraps)
{
	struct decoded d;
	int prev = 0;

	quiet = true;
	spb_node_session_start(0);
	(void)spb_node_service();
	for (int i = 0; i < 300; i++) {
		int seq;

		(void)fake_set_output(0, (i % 2) == 0);
		(void)spb_node_service();
		seq = decode(last(), &d);
		zassert_str_equal(last()->topic, "spBv1.0/Plant1/NDATA/GW01");
		zassert_equal(seq, (prev + 1) % 256, "i=%d", i);
		prev = seq;
	}
}

ZTEST(spb_node, test_dcmd)
{
	uint16_t regs[2];

	spb_node_session_start(0);
	device_online(0, 230.0);
	(void)spb_node_service();

	/* SPEC 7.4: Setpoint=12.3 by name, as a Float */
	send_cmd("spBv1.0/Plant1/DCMD/GW01/Meter1", (struct spb_metric){
		.name = "Setpoint", .has_datatype = true, .datatype = SPB_DT_FLOAT,
		.v.d = 12.3});
	zassert_equal(writes, 1);
	zassert_equal(last_write.dev, 0);
	zassert_equal(last_write.tag, 1);
	zassert_ok(gw_value_to_regs(&model_cfg()->tags[1], last_write.value, regs));
	zassert_equal(regs[0], 123, "12.3 / 0.1 = 123 on the wire");

	/* By alias, Boolean */
	send_cmd("spBv1.0/Plant1/DCMD/GW01/Meter1", (struct spb_metric){
		.has_alias = true, .alias = SPB_ALIAS_TAG_BASE + 2, .datatype = SPB_DT_BOOLEAN,
		.v.b = true});
	zassert_equal(writes, 2);
	zassert_equal(last_write.tag, 2);
	zassert_equal(last_write.value, 1.0);

	/* Rejected: read-only, unknown name, alias of another device's range,
	 * unknown device, non-numeric value.
	 */
	send_cmd("spBv1.0/Plant1/DCMD/GW01/Meter1", (struct spb_metric){
		.name = "Voltage", .datatype = SPB_DT_FLOAT, .v.d = 1});
	send_cmd("spBv1.0/Plant1/DCMD/GW01/Meter1", (struct spb_metric){
		.name = "Nope", .datatype = SPB_DT_FLOAT, .v.d = 1});
	send_cmd("spBv1.0/Plant1/DCMD/GW01/Meter1", (struct spb_metric){
		.has_alias = true, .alias = SPB_ALIAS_TAG_BASE + 3, .datatype = SPB_DT_FLOAT});
	send_cmd("spBv1.0/Plant1/DCMD/GW01/Meter9", (struct spb_metric){
		.name = "Setpoint", .datatype = SPB_DT_FLOAT, .v.d = 1});
	send_cmd("spBv1.0/Plant1/DCMD/GW01/Meter1", (struct spb_metric){
		.name = "Setpoint", .datatype = SPB_DT_STRING, .v.s = "12"});
	zassert_equal(writes, 2, "invalid commands are discarded");
}

ZTEST(spb_node, test_ncmd_outputs_and_reboot)
{
	struct decoded d;
	const struct spb_metric_in *m;

	spb_node_session_start(0);
	(void)spb_node_service();

	send_cmd("spBv1.0/Plant1/NCMD/GW01", (struct spb_metric){
		.name = "DO/3", .has_datatype = true, .datatype = SPB_DT_BOOLEAN, .v.b = true});
	zassert_equal(outputs_set, 1);
	(void)spb_node_service();
	zassert_str_equal(last()->topic, "spBv1.0/Plant1/NDATA/GW01");
	zassert_equal(decode(last(), &d), 1);
	zassert_equal(d.n, 1);
	m = find(&d, NULL, SPB_ALIAS_DO_BASE + 2);
	zassert_true(m && m->v.b, "NDATA confirms DO/3=true");

	/* By alias, and read-only DI is refused */
	send_cmd("spBv1.0/Plant1/NCMD/GW01", (struct spb_metric){
		.has_alias = true, .alias = SPB_ALIAS_DO_BASE + 2, .datatype = SPB_DT_BOOLEAN,
		.v.b = false});
	send_cmd("spBv1.0/Plant1/NCMD/GW01", (struct spb_metric){
		.name = "DI/1", .datatype = SPB_DT_BOOLEAN, .v.b = true});
	zassert_equal(outputs_set, 2);

	send_cmd("spBv1.0/Plant1/NCMD/GW01", (struct spb_metric){
		.name = "Node Control/Reboot", .datatype = SPB_DT_BOOLEAN, .v.b = true});
	zassert_equal(spb_node_service(), SPB_NODE_REQ_REBOOT);
}

ZTEST(spb_node, test_ndeath)
{
	struct msg m = {.topic = "spBv1.0/Plant1/NDEATH/GW01"};
	struct decoded d;

	zassert_ok(spb_node_encode_death(9, m.data, sizeof(m.data), &m.len));
	dump(&m);
	zassert_equal(decode(&m, &d), -1, "NDEATH has no seq");
	zassert_equal(d.n, 1);
	zassert_str_equal(d.m[0].name, "bdSeq");
	zassert_equal(d.m[0].datatype, SPB_DT_UINT64);
	zassert_equal(d.m[0].v.l, 9);
}

ZTEST(spb_node, test_inactive_session_publishes_nothing)
{
	device_online(0, 230.0);
	zassert_equal(spb_node_service(), SPB_NODE_REQ_NONE);
	zassert_equal(n_msgs, 0);
	spb_node_session_start(0);
	spb_node_session_end();
	zassert_equal(spb_node_service(), SPB_NODE_REQ_NONE);
	zassert_equal(n_msgs, 0);
}

ZTEST_SUITE(spb_node, NULL, NULL, before, NULL, NULL);
```

## src/test_util.c
```c
/*
 * SPDX-License-Identifier: Apache-2.0
 */

#include "test_util.h"

#include <string.h>

#include <zephyr/ztest.h>

const char spec_config_json[] =
	"{\n"
	"  \"network\": { \"dhcp\": true, \"ip\": \"192.168.1.50\", \"netmask\": \"255.255.255.0\",\n"
	"               \"gateway\": \"192.168.1.1\", \"dns\": \"192.168.1.1\" },\n"
	"  \"ntp\":     { \"server\": \"pool.ntp.org\" },\n"
	"  \"mqtt\":    { \"host\": \"192.168.1.10\", \"port\": 1883, \"client_id\": \"\",\n"
	"               \"username\": \"\", \"password\": \"\", \"keepalive_s\": 30 },\n"
	"  \"sparkplug\": { \"group_id\": \"Plant1\", \"edge_node_id\": \"GW01\", "
	"\"primary_host_id\": \"\" },\n"
	"  \"rs485\":   { \"baud\": 9600, \"parity\": \"none\", \"stop_bits\": 1,\n"
	"               \"response_timeout_ms\": 200, \"retries\": 2, \"inter_frame_delay_ms\": 5 },\n"
	"  \"local_io\": { \"di_debounce_ms\": 20 },\n"
	"  \"devices\": [\n"
	"    {\n"
	"      \"name\": \"Meter1\", \"unit_id\": 1, \"poll_ms\": 1000, \"offline_after\": 3,\n"
	"      \"tags\": [\n"
	"        { \"name\": \"Voltage\", \"area\": \"input\",   \"address\": 0, \"type\": \"float32\",\n"
	"          \"word_order\": \"big\", \"scale\": 1.0, \"offset\": 0.0, \"deadband\": 0.1,\n"
	"          \"writable\": false, \"units\": \"V\" },\n"
	"        { \"name\": \"Setpoint\", \"area\": \"holding\", \"address\": 10, \"type\": \"int16\",\n"
	"          \"scale\": 0.1, \"writable\": true },\n"
	"        { \"name\": \"Run\",      \"area\": \"coil\",    \"address\": 0, \"type\": \"bool\",\n"
	"          \"writable\": true }\n"
	"      ]\n"
	"    }\n"
	"  ]\n"
	"}\n";

static struct gw_config cfg;
static char err[GW_CFG_ERR_MAX];

struct gw_config *test_config_load(const char *json)
{
	int ret = gw_config_parse(json, strlen(json), &cfg, err, sizeof(err));

	zassert_ok(ret, "unexpected parse error: %s", err);
	return &cfg;
}

const char *test_config_error(const char *json)
{
	int ret = gw_config_parse(json, strlen(json), &cfg, err, sizeof(err));

	zassert_equal(ret, -EINVAL, "document unexpectedly accepted: %s", json);
	return err;
}
```

## src/test_util.h
```c
/*
 * Shared helpers for the gateway unit tests.
 *
 * SPDX-License-Identifier: Apache-2.0
 */

#ifndef GW_TEST_UTIL_H_
#define GW_TEST_UTIL_H_

#include "gw_config.h"

/* The example document of SPEC section 6, verbatim. */
extern const char spec_config_json[];

/* Parse @p json into the shared test configuration; asserts on failure. */
struct gw_config *test_config_load(const char *json);

/* Parse @p json and return the error text; asserts that parsing fails. */
const char *test_config_error(const char *json);

#endif /* GW_TEST_UTIL_H_ */
```
